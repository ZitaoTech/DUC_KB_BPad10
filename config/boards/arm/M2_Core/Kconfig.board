## config/boards/arm/M2_Core/Kconfig.board
```kconfig
# Copyright (c) 2020 Stefan Sundin (4pplet)
# SPDX-License-Identifier: MIT
 

config BOARD_M2_CORE
	bool "M2_Core"
	depends on SOC_NRF52840_QIAA
```

## config/west.yml
```yaml
manifest:
  remotes:
    - name: zmkfirmware
      url-base: https://github.com/zmkfirmware
    - name: WSTRN
      url-base: https://github.com/WSTRN
  projects:
    - name: zmk
      remote: WSTRN
      revision: main
      import: app/west.yml
  self:
    path: config
```
